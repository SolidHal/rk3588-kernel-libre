## drivers/clk/rockchip/Kconfig
```kconfig
# SPDX-License-Identifier: GPL-2.0
# common clock support for ROCKCHIP SoC family.

config COMMON_CLK_ROCKCHIP
	bool "Rockchip clock controller common support"
	depends on ARCH_ROCKCHIP
	default ARCH_ROCKCHIP
	help
	  Say y here to enable common clock controller for Rockchip platforms.

if COMMON_CLK_ROCKCHIP
config CLK_PX30
	bool "Rockchip PX30 clock controller support"
	depends on ARM64 || COMPILE_TEST
	default y
	help
	  Build the driver for PX30 Clock Driver.

config CLK_RV110X
	bool "Rockchip RV110x clock controller support"
	depends on ARM || COMPILE_TEST
	default y
	help
	  Build the driver for RV110x Clock Driver.

config CLK_RK1808
   tristate "Rockchip RK1808 clock controller support"
   depends on ARM64 || COMPILE_TEST
   default y
   help
     Build the driver for RK1808 Clock Driver.

config CLK_RK3036
	bool "Rockchip RK3036 clock controller support"
	depends on ARM || COMPILE_TEST
	default y
	help
	  Build the driver for RK3036 Clock Driver.

config CLK_RK312X
	bool "Rockchip RK312x clock controller support"
	depends on ARM || COMPILE_TEST
	default y
	help
	  Build the driver for RK312x Clock Driver.

config CLK_RK3188
	bool "Rockchip RK3188 clock controller support"
	depends on ARM || COMPILE_TEST
	default y
	help
	  Build the driver for RK3188 Clock Driver.

config CLK_RK322X
	bool "Rockchip RK322x clock controller support"
	depends on ARM || COMPILE_TEST
	default y
	help
	  Build the driver for RK322x Clock Driver.

config CLK_RK3288
	bool "Rockchip RK3288 clock controller support"
	depends on ARM || COMPILE_TEST
	default y
	help
	  Build the driver for RK3288 Clock Driver.

config CLK_RK3308
	bool "Rockchip RK3308 clock controller support"
	depends on ARM64 || COMPILE_TEST
	default y
	help
	  Build the driver for RK3308 Clock Driver.

config CLK_RK3328
	bool "Rockchip RK3328 clock controller support"
	depends on ARM64 || COMPILE_TEST
	default y
	help
	  Build the driver for RK3328 Clock Driver.

config CLK_RK3368
	bool "Rockchip RK3368 clock controller support"
	depends on ARM64 || COMPILE_TEST
	default y
	help
	  Build the driver for RK3368 Clock Driver.

config CLK_RK3399
	bool "Rockchip RK3399 clock controller support"
	depends on ARM64 || COMPILE_TEST
	default y
	help
	  Build the driver for RK3399 Clock Driver.

config CLK_RK3568
	bool "Rockchip RK3568 clock controller support"
	depends on ARM64 || COMPILE_TEST
	default y
	help
	  Build the driver for RK3568 Clock Driver.

config CLK_RK3588
	tristate "Rockchip RK3588 clock controller support"
	depends on ARM64 || COMPILE_TEST
	default y
	help
	  Build the driver for RK3588 Clock Driver.

config ROCKCHIP_CLK_COMPENSATION
   bool "Rockchip Clk Compensation"
   help
     Say y here to enable clk compensation(+/- 1000 ppm).

config ROCKCHIP_CLK_LINK
   tristate "Rockchip clock link support"
   default CLK_RK3588
   help
     Say y here to enable clock link for Rockchip.

config ROCKCHIP_CLK_BOOST
   bool "Rockchip Clk Boost"
   help
     Say y here to enable clk boost.

config ROCKCHIP_CLK_INV
   bool "Rockchip Clk Inverter"
   help
     Say y here to enable clk Inverter.

config ROCKCHIP_CLK_PVTM
   bool "Rockchip Clk Pvtm"
   help
     Say y here to enable clk pvtm.

config ROCKCHIP_DDRCLK
   bool

config ROCKCHIP_DDRCLK_SCPI
   bool "Rockchip DDR Clk SCPI"
   select ROCKCHIP_DDRCLK
   help
     Say y here to enable ddr clk scpi.

config ROCKCHIP_DDRCLK_SIP
   bool "Rockchip DDR Clk SIP"
   select ROCKCHIP_DDRCLK
   help
     Say y here to enable ddr clk sip.

config ROCKCHIP_DDRCLK_SIP_V2
   bool "Rockchip DDR Clk SIP V2"
   select ROCKCHIP_DDRCLK
   help
     Say y here to enable ddr clk sip v2.

config ROCKCHIP_PLL_RK3066
   bool "Rockchip PLL Type RK3066"
   help
     Say y here to enable pll type is rk3066.

config ROCKCHIP_PLL_RK3399
   bool "Rockchip PLL Type RK3399"
   help
     Say y here to enable pll type is rk3399.

config ROCKCHIP_PLL_RK3588
   bool "Rockchip PLL Type RK3588"
   default y if CPU_RK3588
   help
     Say y here to enable pll type is rk3588.

endif
```

## drivers/staging/android/Kconfig
```kconfig
menu "Android"

if ANDROID

source "drivers/staging/android/fiq_debugger/Kconfig"

endif # if ANDROID

endmenu
```
